## firmware/interaction/sdkconfig.defaults
```kconfig
CONFIG_IDF_TARGET="esp32s3"
CONFIG_ESPTOOLPY_FLASHSIZE_16MB=y
CONFIG_SPIRAM=y
CONFIG_SPIRAM_MODE_OCT=y
CONFIG_SPIRAM_SPEED_80M=y
CONFIG_PARTITION_TABLE_CUSTOM=y
CONFIG_PARTITION_TABLE_CUSTOM_FILENAME="partitions.csv"
CONFIG_ESP_MAIN_TASK_STACK_SIZE=16384
CONFIG_MORI_INTERACTION_BOARD_VERIFIED=n
CONFIG_MORI_ENABLE_PHYSICAL_CAMERA=n
CONFIG_MORI_ENABLE_PHYSICAL_AUDIO=n
CONFIG_MORI_ENABLE_PHYSICAL_DISPLAY=n
CONFIG_MORI_ENABLE_PHYSICAL_BUTTON=n
```

## firmware/motion/sdkconfig.defaults
```kconfig
CONFIG_IDF_TARGET="esp32s3"
CONFIG_ESPTOOLPY_FLASHSIZE_8MB=y
CONFIG_ESP_CONSOLE_UART_DEFAULT=y
CONFIG_FREERTOS_HZ=1000
CONFIG_ESP_TASK_WDT_EN=y
CONFIG_ESP_TASK_WDT_INIT=y
CONFIG_ESP_TASK_WDT_TIMEOUT_S=1
CONFIG_ESP_TASK_WDT_PANIC=y
CONFIG_ESP_MAIN_TASK_STACK_SIZE=8192
CONFIG_MORI_ENABLE_BALANCE=n
CONFIG_MORI_POWER_STAGE_VERIFIED=n
CONFIG_MORI_LCD_ENABLE=y

CONFIG_MORI_HEAD_VERIFIED=n
CONFIG_MORI_AXES_VERIFIED=n
```

## hardware/revisions/A0.5/firmware/main/Kconfig.projbuild
```kconfig
menu "MORI hardware validation"
config MORI_POWER_STAGE_VERIFIED
    bool "Independent electrical gate, limit and clamp checks signed off (permits bench unlock)"
    default n
    help
        Enable only after the emergency stop, sleep pull-down, heartbeat timeout,
        current-limit modification and bus clamp have passed physical checks.
config MORI_ENABLE_BALANCE
    bool "Compile experimental balance arming support"
    default n
    help
        Requires measured axes/signs, calibrated IMU, explicit serial arming,
        nonzero reviewed gains, local fall protection and hardware verification.
config MORI_LCD_ENABLE
    bool "Enable low-priority GC9A01 display test"
    default y
config MORI_HEAD_VERIFIED
    bool "SER0037 centre, direction, linkage and safe pulse range physically verified"
    default n
    help
        Required for any head PWM. The nominal 270 degree mapping is only a
        commissioning starting point. Remove the linkage for first centring.
endmenu
```

## robot/firmware/interaction/main/Kconfig.projbuild
```kconfig
menu "MORI interaction evidence gates"
config MORI_INTERACTION_BOARD_VERIFIED
    bool "Hardware pin/power contract verified"
    default n
config MORI_ENABLE_PHYSICAL_CAMERA
    bool "Camera tested"
    depends on MORI_INTERACTION_BOARD_VERIFIED
    default n
config MORI_ENABLE_PHYSICAL_AUDIO
    bool "Audio tested"
    depends on MORI_INTERACTION_BOARD_VERIFIED
    default n
config MORI_ENABLE_PHYSICAL_DISPLAY
    bool "Display tested"
    depends on MORI_INTERACTION_BOARD_VERIFIED
    default n
config MORI_ENABLE_PHYSICAL_BUTTON
    bool "Button tested"
    depends on MORI_INTERACTION_BOARD_VERIFIED
    default n
endmenu
```

## robot/firmware/motion/main/Kconfig.projbuild
```kconfig
menu "MORI hardware validation"
config MORI_LEGACY_BENCH_PROFILE
    bool "Explicit A0.5 bench profile (NOT V1 hardware)"
    default n
    help
        Retains original tested drivers and pin candidates. Never flash to an
        unspecified V1 board. V1 default initializes no motor or sensor GPIO.
config MORI_POWER_STAGE_VERIFIED
    bool "Independent electrical gate, limit and clamp checks signed off (permits bench unlock)"
    default n
    help
        Enable only after the emergency stop, sleep pull-down, heartbeat timeout,
        current-limit modification and bus clamp have passed physical checks.
config MORI_ENABLE_BALANCE
    bool "Compile experimental balance arming support"
    default n
    help
        Requires measured axes/signs, calibrated IMU, explicit serial arming,
        nonzero reviewed gains, local fall protection and hardware verification.
config MORI_LCD_ENABLE
    bool "Enable low-priority GC9A01 display test"
    default y
config MORI_HEAD_VERIFIED
    bool "SER0037 centre, direction, linkage and safe pulse range physically verified"
    default n
    help
        Required for any head PWM. The nominal 270 degree mapping is only a
        commissioning starting point. Remove the linkage for first centring.
config MORI_AXES_VERIFIED
    bool "Signed six-face, pitch, encoder and motor direction record exists"
    default n
    help
        Validating an orthonormal matrix does NOT validate the actual mounting.
        Required before confirm_signs and balance. Keep n until measured.
endmenu
```
